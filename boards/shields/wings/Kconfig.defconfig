## boards/shields/wings/Kconfig.defconfig
```kconfig
if SHIELD_WINGS_LEFT

config ZMK_KEYBOARD_NAME
    default "Wings"

config ZMK_SPLIT_ROLE_CENTRAL
    default y

endif

if SHIELD_WINGS_RIGHT

config CONFIG_CLOCK_CONTROL_NRF_K32SRC_RC
    default y

endif

if SHIELD_WINGS_LEFT || SHIELD_WINGS_RIGHT

config ZMK_SPLIT
    default y

endif
```
